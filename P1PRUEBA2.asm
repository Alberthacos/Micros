
				INCLUDE			<ENCABEZADO.INC>
				CLRF 			TRISC
				CLRF			TRISB	
				BCF				STATUS,RP0	;B0
				CLRF			0X20
				CLRF			0X21
				CLRF			0X22
				;BSF				PORTB,0
				;MOVLW			0X80
				;MOVWF			PORTD	
PUSHBUTTON:		BTFSS			PORTB,0
				GOTO			PUSHBUTTON
				MOVF			PORTD,W
				MOVWF			PORTC
				MOVWF			0X20
							
MENU:			BCF		 		PORTB,0
				;BSF				PORTB,3
				BTFSC      		PORTB,1
				GOTO 	        OPERACION_1
				BTFSC           PORTB,2
				GOTO            OPERACION_2
				BTFSC           PORTB,3
				GOTO            OPERACION_3
				GOTO            MENU

OPERACION_1:	MOVF            0X20,W
				ADDWF			PORTD,W
				MOVWF			PORTC
				BTFSC			STATUS, C
				BSF				PORTB,7
				GOTO			DIVISION
		
OPERACION_2:	MOVF            PORTD,W
				SUBWF			0X20,W
				BTFSS			STATUS,C
				GOTO			NEGATIVO
REGRESAR:		MOVWF			PORTC
				GOTO			DIVISION
NEGATIVO:		SUBLW			0X00
				BSF				PORTB,7
				GOTO			REGRESAR
		
OPERACION_3:	CLRF			PORTB
				;MOVLW			0X07
				;MOVWF			PORTD
				MOVF			0X20,W
				MOVWF			0X21
				MOVF			0X21,F
				BTFSC			STATUS,Z
				GOTO			ZERO
				MOVF			PORTD,W
				MOVWF			0X22
				SUBWF			0X21,W
				BTFSC			STATUS,C
				GOTO 			MULTPLICACION2
				MOVF			PORTD,W		;INICIA LA SUMA EN EL VALOR DEL PORTD
MULTIPLICACION:	DECFSZ			0X21,F
				ADDWF			PORTD,W
				MOVF			0X21,F
				BTFSC			STATUS,C
				BSF				PORTB,7
				BTFSS			STATUS,Z			
				GOTO			MULTIPLICACION
				GOTO			ASIGNA

MULTPLICACION2: MOVF			0X21,W
CICLO:			DECFSZ			0X22,F
				ADDWF			0X21,W
				MOVF			0X22,F
				BTFSC			STATUS,C
				BSF				PORTB,7
				BTFSS			STATUS,Z			
				GOTO			CICLO
				GOTO			ASIGNA

ASIGNA:			MOVWF			PORTC
				GOTO			DIVISION
ZERO:			MOVLW			0X00
				GOTO			ASIGNA


DIVISION:		BTFSS           PORTB,0
				GOTO            DIVISION
				MOVF			0X20,F
				BTFSC			STATUS,Z    ;0X20 DISTINTO DE 0?
				GOTO			CERO
				MOVF			PORTD,F
				BTFSC			STATUS,Z    ;PORTD DISTINTO DE 0?
				GOTO			INDEFINIDO
				MOVF			PORTD,W
				SUBWF			0X20,W
				BTFSS			STATUS,C    ;0X20>PORTD?
				GOTO			CERO2
		
				MOVF			0X20,W	    ;GUARDA 0X20 EN W
				MOVWF			0X21	    ; VALOR DE 0X20 => 0X21
				MOVF			PORTD,W	    ;GUARDA PORTD EN W
		
				CLRF			0X22	    ;LIMPIA COCIENTE
		
OPERACION:		SUBWF			0X21,F	    ;REGX21=REG0X21-PORTD
				BTFSC			STATUS,C    ;¿NO HAY ACARREO?
				BTFSS			STATUS,Z    ;¿0X21==0?	   
				GOTO			COCIENTE
				INCFSZ			0X22,F 		;COCIENTE
				BCF				PORTB,7	    ;PORTB.7
FINAL:			MOVF			0X22,W
				MOVWF			PORTC	    
				GOTO			FINAL2
COCIENTE:		INCFSZ			0X22,F		;COCIENTE
				BTFSC			STATUS,C
				GOTO			OPERACION
				GOTO			RESIDUO
		
RESIDUO:		DECFSZ			0X22,F
				BSF				PORTB,7
				GOTO			FINAL
			
CERO:			BCF				PORTB,7
				MOVLW  			0X00
				MOVWF			PORTC
				GOTO			FINAL2

CERO2:			BSF				PORTB,7
				MOVLW  			0X00
				MOVWF			PORTC
				GOTO			FINAL2
    
INDEFINIDO:		BSF				PORTB,7
				MOVLW			0XFF
				MOVWF			PORTC
FINAL2:			GOTO			$
				END
		
		