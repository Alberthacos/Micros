
			INCLUDE <ENCABEZADO_2.2.ASM>

;DEFINIMOS LAS SALIDAS DEL MICROCONTROLADOR
			CLRF		TRISC			;PORTC SALIDA 
			BCF			TRISB,1
			BCF			STATUS,RP0		;B0
			
		

;*********************************************************************************************
;DECLARACION DE REGISTROS A EMPLEAR
			POSICION1 	EQU		0X20	;GUARDAMOS EN UN REGISTRO DE PROPOSITO GENERAL	
			TIEMPO1		EQU		0X21	;CADA UNO DE LOS DATOS INGRESADOS POR EL USUARIO
										;A TRAVES DEL PORTD	
			POSICION2 	EQU		0X22	
			TIEMPO2		EQU		0X23
	
			POSICION3 	EQU		0X24	
			TIEMPO3		EQU		0X25
	
			POSICION4	EQU		0X26
			TIEMPO4		EQU		0X27

			POSICION5	EQU		0X28
			TIEMPO5		EQU		0X29
;REGISTROS DE APOYO PARA SABER LA DIFERENCIA ENTRE LA POSCION ACTUAL Y LA POSTERIOR
			DATO		EQU		0X31
			DATO2		EQU		0X32
			DATO3		EQU		0X33
			DATO4		EQU		0X34

;******************************************************************************************
;ENVIAMOS EL MOTOR A LA POSICION 0 GRADOS

POSICION_0:	BSF			PORTB,1			;ENCENDEMOS EL LED DEL SENSOR
;			PIZQ						;GIRAMOS EL MOTOR A LA IZQUIERDA
;			BTFSS		PORTB,0			;SALIDA DEL FOTORANSISTOR QUE PREGUNTA SI B7=1?	
;			GOTO		POSICION_0		;NO, VUELVE A REPETIR EL CICLO
;			APAGADO						;APAGA EL MOTOR
;			BCF			PORTB,1			;APAGA EL LED DEL SENSOR

;GUARDAMOS POSICIONES Y TIEMPOS (PARA LAS 5 POSICIONES Y 5 TIEMPOS HACEMOS LO MISMO)

			;PUSH_ANTIR	PORTB,0			;B0 FUE PULSADO?
			;MOVF		PORTD,W			;LEE LO QUE  TIENE EL PUERTO D Y CARGALO EN EL ACUMULADOR
			;MOVWF		POSICION1		;W->POSICION1
			;MOVWF		DATO			;REGISTRO DE APOYO PARA LA DIFERENCIA DE GRADOS (CUANTO LE FALTA GIRAR PARA LLEGAR A ESA POSICION) (W->DATO)
			;MOVWF		PORTC			;REGISTRO DE APOYO PARA LA DIFERENCIA DE GRADOS (CUANTO LE FALTA GIRAR PARA LLEGAR A ESA POSICION) (W->DATO)
			;PUSH_ANTIR	PORTB,0			;B0 FUE PULSADO?
			;MOVF		PORTD,W			;LEE LO QUE  TIENE EL PUERTO D Y CARGALO EN EL ACUMULADOR
			;MOVWF		TIEMPO1			;GUARDALO EN EL TIEMPO 1

			;PUSH_ANTIR	PORTB,0			;B0 FUE PULSADO?
			;MOVF		PORTD,W			;W=PORTD
			;MOVWF		POSICION2		;W->POSICION2
			;MOVWF		DATO2			;W->DATO2
			;PUSH_ANTIR	PORTB,0			;B0 FUE PULSADO?
			;MOVF		PORTD,W			;W=PORTD
			;MOVWF		TIEMPO2			;W->TIEMPO2

			;PUSH_ANTIR	PORTB,0			;B0 FUE PULSADO?
			;MOVF		PORTD,W			;W=PORTD
			;MOVWF		POSICION3		;W->POSICION3
			;MOVWF		DATO3			;W->DATO3
			;PUSH_ANTIR	PORTB,0			;B0 FUE PULSADO?
			;MOVF		PORTD,W			;W=PORTD
			;MOVWF		TIEMPO3			;W->TIEMPO3
		
			;PUSH_ANTIR	PORTB,0			;B0 FUE PULSADO?
			;MOVF		PORTD,W			;W=PORTD
			;MOVWF		POSICION4		;W->POSICION4
			;MOVWF		DATO4			;W->DATO4
			;PUSH_ANTIR	PORTB,0			;B0 FUE PULSADO?
			;MOVF		PORTD,W			;W=PORTD
			;MOVWF		TIEMPO4			;W->TIEMPO4

			;PUSH_ANTIR	PORTB,0			;B0 FUE PULSADO?
			;MOVF		PORTD,W			;W=PORTD
			;MOVWF		POSICION5		;W->POSICION4
			;PUSH_ANTIR	PORTB,0			;B0 FUE PULSADO?
			;MOVF		PORTD,W			;W=PORTD
			;MOVWF		TIEMPO5			;W->TIEMPO5

			PUSH_ANTIR	PORTB,0			;B0 FUE PULSADO?
            MOVLW       .362
            MOVWF       POSICION1

;*****************************************************************************************
;EJECUTA LA POSICION 1

POSI_1:		PIZQ						;GIRAMOS EL MOTOR A LA IZQUIERDA
			DECFSZ		POSICION1,F		;POSICION1-1=0?
			GOTO		POSI_1			;NO, SALTA A POSI_1
			APAGADO						;APAGA EL MOTOR
			CALL		T_1S			;LLAMA A 1 SEGUNDO
T1_D:		DECFSZ		TIEMPO1,F		;TIEMPO1-1=0?
			GOTO		SEG_POS_1		;NO, SALTA A SEG_POS_1
			GOTO		FIN			;SALTA A POSI_2
SEG_POS_1:	CALL		T_1S			;LLAMA A 1 SEGUNDO
			GOTO		T1_D			;SALTA A T1_D
            
;*****************************************************************************************
;EJECUTA LA POSICION 2 (ESTE PROCEDIMIENTO ES SIMILAR HASTA LA POSICION 5)

POSI_2:		MOVF 		DATO,W			;POSICION1=DATO=W
			SUBWF		POSICION2,W		;POSICION2-POSICION1
			MOVWF		DATO			;W->DATO
			BTFSC		STATUS,Z		;Z=0?
			GOTO		T2_D			;NO, SIGNIFICA QUE LAS POSICIONES SON LAS MISMAS (DECREMENTA EL TIEMPO)
			MOVF		DATO,W			;W=DATO
			BTFSC		STATUS,C		;C=0? 
			GOTO		GIRA_ANT_2		;NO, SALTA A GIRA_ANT_2
			MOVF		DATO,W			;W=DATO
			SUBLW		0X00			;DATO-0X00
			MOVWF		DATO			;W->DATO
			GOTO		GIRA_HOR_2		;SALTA A GIRA_HOR_2
			
GIRA_ANT_2:	PIZQ						;GIRAMOS EL MOTOR A LA IZQUIERDA
			DECFSZ	DATO,F				;DATO-1=0?
			GOTO	GIRA_ANT_2			;NO, SALTA A GIRA_ANT_2
			APAGADO						;APAGA EL MOTOR
			CALL	T_1S				;LLAMA A 1 SEGUNDO
			GOTO	T2_D				;SALTA A T2_D

GIRA_HOR_2:	PDER						;GIRAMOS EL MOTOR A LA DERECHA
			DECFSZ	DATO,F				;DATO-1=0?
			GOTO	GIRA_HOR_2			;NO, SALTA A GIRA_HOR_2
			APAGADO						;APAGA EL MOTOR
			CALL	T_1S				;LLAMA A 1 SEGUNDO
			GOTO	T2_D				;SALTA A T2_D

T2_D:		DECFSZ		TIEMPO2,F		;TIEMPO2-1=0?
			GOTO		SEG_POS_2		;NO, LLAMA A 1 SEGUNDO
			GOTO		POSI_3			;SALTA A POSI_3

SEG_POS_2:	CALL		T_1S			;LLAMA A 1 SEGUNDO
			GOTO		T2_D			;VUELVE A DECREMENTAR EL TIEMPO

;******************************************************************************************
;EJECUTA LA POSICION 3
POSI_3:		MOVF 		DATO2,W			
			SUBWF		POSICION3,W		;POSICION3-POSICION2
			MOVWF		DATO2
			BTFSC		STATUS,Z		
			GOTO		T3_D			
			MOVF		DATO2,W			
			BTFSC		STATUS,C		
			GOTO		GIRA_ANT_3
			MOVF		DATO2,W
			SUBLW		0X00
			MOVWF		DATO2
			GOTO		GIRA_HOR_3

GIRA_ANT_3:	PIZQ						;GIRAMOS EL MOTOR A LA IZQUIERDA
			DECFSZ	DATO2,F
			GOTO	GIRA_ANT_3
			APAGADO
			CALL	T_1S
			GOTO	T3_D

GIRA_HOR_3:	PDER						;GIRAMOS EL MOTOR A LA DERECHA
			DECFSZ	DATO2,F
			GOTO	GIRA_HOR_3
			APAGADO
			CALL	T_1S
			GOTO	T3_D

T3_D:		DECFSZ		TIEMPO3,F		
			GOTO		SEG_POS_3		
			GOTO		POSI_4			;SALTA A POSI_4
SEG_POS_3:	CALL		T_1S
			GOTO		T3_D			

;******************************************************************************************
;EJECUTA LA POSICION 4
					
POSI_4:		MOVF 		DATO3,W			
			SUBWF		POSICION4,W		;POSICION4-POSICION3
			MOVWF		DATO3
			BTFSC		STATUS,Z		
			GOTO		T4_D			
			MOVF		DATO3,W			
			BTFSC		STATUS,C		
			GOTO		GIRA_ANT_4
			MOVF		DATO3,W
			SUBLW		0X00
			MOVWF		DATO3
			GOTO		GIRA_HOR_4
			
GIRA_ANT_4:	PIZQ						;GIRAMOS EL MOTOR A LA IZQUIERDA
			DECFSZ	DATO3,F
			GOTO	GIRA_ANT_4
			APAGADO
			CALL	T_1S
			GOTO	T4_D

GIRA_HOR_4:	PDER						;GIRAMOS EL MOTOR A LA DERECHA
			DECFSZ	DATO3,F
			GOTO	GIRA_HOR_4
			APAGADO
			CALL	T_1S
			GOTO	T4_D

T4_D:		DECFSZ		TIEMPO4,F		
			GOTO		SEG_POS_4		
			GOTO		POSI_5			;SALTA A POSI_5
SEG_POS_4:	CALL		T_1S
			GOTO		T4_D			

;******************************************************************************************
;EJECUTA LA POSICION 5
					
POSI_5:		MOVF 		DATO4,W			;POSICION4=DATO4=W	
			SUBWF		POSICION5,W		;POSICION5-POSICION4
			MOVWF		DATO4			;W->DATO4
			BTFSC		STATUS,Z		;Z=0?
			GOTO		T5_D			;NO, SIGNIFICA QUE LAS POSICIONES SON LAS MISMAS (DECREMENTA EL TIEMPO)
			MOVF		DATO4,W			;W=DATO4
			BTFSC		STATUS,C		;C=0? 
			GOTO		GIRA_ANT_5		;NO, SALTA A GIRA_ANT_5
			MOVF		DATO4,W			;W=DATO4
			SUBLW		0X00			;DATO4-0X00
			MOVWF		DATO4			;W->DATO4
			GOTO		GIRA_HOR_5		;SALTA A GIRA_HOR_5
			
GIRA_ANT_5:	PIZQ						;GIRAMOS EL MOTOR A LA IZQUIERDA
			DECFSZ	DATO4,F				;DATO4-1=0?
			GOTO	GIRA_ANT_5			;NO, SALTA A GIRA_ANT_5
			APAGADO						;APAGA EL MOTOR
			CALL	T_1S				;LLAMA A 1 SEGUNDO
			GOTO	T5_D				;SALTA A T5_D

GIRA_HOR_5:	PDER						;GIRAMOS EL MOTOR A LA DERECHA
			DECFSZ	DATO4,F				;DATO4-1=0?
			GOTO	GIRA_HOR_5			;NO, SALTA A GIRA_HOR_5
			APAGADO						;APAGA EL MOTOR
			CALL	T_1S				;LLAMA A 1 SEGUNDO
			GOTO	T5_D				;SALTA A T5_D

T5_D:		DECFSZ		TIEMPO5,F		;TIEMPO5-1=0?
			GOTO		SEG_POS_5		;NO, SALTA A SEG_POS_5
			GOTO       	POSICION_0		;SALTA A POSICION_0
SEG_POS_5:	CALL		T_1S			;LLAMA A 1 SEGUNDO
			GOTO		T5_D			;SALTA A T5_D


T_1S:		SUBT3V		.79,.10,.171	;999995 us
			RETURN	

T10MS:		SUBT3V		.5,.1,.163		;8994 us
			RETURN		

T12MS:		SUBT3V		.21,.11,.7		;12mS
			RETURN

T25MS:		SUBT3V		.67,.17,.3		;25mS
			RETURN			
	
FIN:        GOTO        $

			INCLUDE <SUBTIEMPO_2.2.ASM>
			END