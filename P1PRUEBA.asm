
				INCLUDE			<ENCABEZADO.INC>
				CLRF 			TRISC
				BCF				TRISB,7		;SACA 0 en PORTB,7
				BCF				STATUS,RP0	;B0
				CLRF			0X20	
				CLRF			0X21
				CLRF			0X22	
PUSHBUTTON:		BTFSS			PORTA,0			;PORTA.0 = 1?
				GOTO			PUSHBUTTON		;SI  PORTA.0 = 0 
				MOVF			PORTB,W			;SI  PORTA.0 = 1 
				MOVWF			PORTC
				MOVWF			0X20			;ASIGNA EL VALOR DEL PORTD AL REG0X20 Y PORTC, MOSTRANDOLO

					

SUMA:			BTFSS			PORTA,1			
				GOTO 			SUMA			;SI  PORTA.1 = 0 
				MOVF            0X20,W			;SI  PORTA.1 = 1 --  REG0X20 A W 
				ADDWF			PORTB,W			;SUMA REG0X20+PORTD
				MOVWF			PORTC			;PORTC=RESULTADO
				GOTO			$
				END
				

MENU:			BCF		 		PORTA,0			;PORTA.0=0
				BTFSC      		PORTA,1			;PORTA.1 = 1?
				GOTO 	        OPERACION_1		;VE A SUMA
				BTFSC           PORTA,2			;PORTA.2 = 1?
				GOTO            OPERACION_2		;VE A RESTA
				BTFSC           PORTA,3			;PORTA.3 = 1?
				GOTO            OPERACION_3		;VE A MULTIPLICACION
				GOTO            MENU			;REGRESA A MENU
	
OPERACION_1:	MOVF            0X20,W			;REG0X20 A W, 
				ADDWF			PORTD,W			;SUMA REG0X20+PORTD
				MOVWF			PORTC			;PORTC=RESULTADO
				BTFSC			STATUS, C		;SOBREPASA EL ACARREO?
				BSF				PORTA,7			;SI C=1 ENTONCES PORTB.7=1
				GOTO			DIVISION		;VE A DIVISION 
		
OPERACION_2:	MOVF            PORTD,W			;PORTD A W, 
				SUBWF			0X20,W			;RESTA REG0X20-PORTD
				BTFSS			STATUS,C		;ES POSITIVO?
				GOTO			NEGATIVO		
REGRESAR:		MOVWF			PORTC			;PORTC=RESULTADO
				GOTO			DIVISION		;VE A DIVISION 
		;
NEGATIVO:		SUBLW			0X00			;SUMA CERO OBTENIENDO MAGNITUD DEL RESULTADO NEGATIVO
				BSF				PORTB,7			;PORTB.7=1
				GOTO			REGRESAR
		
	
OPERACION_3:	MOVF			0X20,W		
				MOVWF			0X21
				MOVF			0X21,F
				BTFSC			STATUS,Z		;REG0X21=0?
				GOTO			ZERO			
				MOVF			PORTD,W			
				MOVWF			0X22
				MOVF			0X22,W
				BTFSC			STATUS,Z		;0X22=0?
				GOTO			ZERO				
				SUBWF			0X21,W
				BTFSC			STATUS,C		;REG0X21>REG0X22?
				GOTO 			MULTPLICACION2
				MOVF			PORTD,W			;INICIA LA SUMA EN EL VALOR DEL PORTD

MULTIPLICACION:	DECFSZ			0X21,F			;REG0X21-1
				ADDWF			PORTD,W			;SUMA PORTD+PORTD
				MOVF			0X21,F			
				BTFSC			STATUS,C		;SOBREPASA EL ACARREO?
				BSF				PORTB,7			
				BTFSS			STATUS,Z		;REG0X21=0?	
				GOTO			MULTIPLICACION
				GOTO			ASIGNA


MULTPLICACION2: MOVF			0X21,W			;W=REG0X21
CICLO:			DECFSZ			0X22,F			;REG0X22-1
				ADDWF			0X21,W			;SUMA REG0X21+REG0X21
				MOVF			0X22,F			
				BTFSC			STATUS,C		;SOBREPASA EL ACARREO?
				BSF				PORTB,7			
				BTFSS			STATUS,Z		;REG0X22=0?	
				GOTO			CICLO
				GOTO			ASIGNA

ASIGNA:			MOVWF			PORTC			;PORTC=W Y LO MUESTRA.
				GOTO			DIVISION

ZERO:			MOVLW			0X00			;W=.0
				GOTO			ASIGNA


DIVISION:		BTFSS           PORTB,0
				GOTO            DIVISION
				MOVF			0X20,F
				BTFSC			STATUS,Z    ;0X20 DISTINTO DE 0?
				GOTO			CERO
				MOVF			PORTD,F
				BTFSC			STATUS,Z    ;PORTD DISTINTO DE 0?
				GOTO			INDEFINIDO
				MOVF			PORTD,W
				SUBWF			0X20,W
				BTFSS			STATUS,C    ;0X20>PORTD?
				GOTO			CERO2
		
				MOVF			0X20,W	    ;GUARDA 0X20 EN W
				MOVWF			0X21	    ; VALOR DE 0X20 => 0X21
				MOVF			PORTD,W	    ;GUARDA PORTD EN W
		
				CLRF			0X22	    ;LIMPIA COCIENTE
		
OPERACION:		SUBWF			0X21,F	    ;0X21=0X21-PORTD
				BTFSC			STATUS,C    ;¿NO HAY ACARREO?
				BTFSS			STATUS,Z    ;¿0X21==0?	   
				GOTO			COCIENTE
				INCFSZ			0X22,F 		;COCIENTE
				BCF				PORTB,7	    ;PORTB.7
FINAL:			MOVF			0X22,W
				MOVWF			PORTC	    
				GOTO			FINAL2
COCIENTE:		INCFSZ			0X22,F		;COCIENTE
				BTFSC			STATUS,C
				GOTO			OPERACION
				GOTO			RESIDUO
		
RESIDUO:		DECFSZ			0X22,F
				BSF				PORTB,7		
				GOTO			FINAL
			
CERO:			BCF				PORTB,7
				MOVLW  			0X00
				MOVWF			PORTC
				GOTO			FINAL2

CERO2:			BSF				PORTB,7
				MOVLW  			0X00
				MOVWF			PORTC
				GOTO			FINAL2
    
INDEFINIDO:		BSF				PORTB,7
				MOVLW			0XFF
				MOVWF			PORTC
FINAL2:			GOTO			$
				END
		
		



		';;;;;;;;;;;;;;;;;;;;;;;;;;;;;;;;;;;;;;;;;;;;;;;;;;;;;;;;;;;;;;;;;;;



		
				INCLUDE			<ENCABEZADO.INC>
				CLRF 			TRISC
				BCF				TRISB,7		;SACA 0 en PORTB,7
				BCF				STATUS,RP0	;B0
				CLRF			0X20	
				CLRF			0X21
				CLRF			0X22	

PUSHBUTTON:		BTFSS			PORTB,0			;PORTA.0 = 1?
				GOTO			PUSHBUTTON		;SI  PORTA.0 = 0 
				MOVF			PORTD,W			;SI  PORTA.0 = 1 // CARGA EL VALOR EN EL ACUMULADOR 
				MOVWF			PORTC			;ASIGNA EL VALOR DEL ACUMULADOR AL
				MOVWF			0X20			;REG0X20 Y PORTC

SUMA:			BTFSS			PORTB,1			
				GOTO 			RESTA			;SI  PORTA.1 = 0 
				MOVF            0X20,W			;SI  PORTA.1 = 1   REG0X20 -->> W 
				ADDWF			PORTD,W			;SUMA REG0X20 + PORTD
				MOVWF			PORTC			;PORTC = RESULTADO
				
RESTA:			BTFSS			PORTB,2	
				GOTO 			MULTIPLICACION
				MOVF			PORTD,W			;CARGA EL VALOR DE PORTD EN W 			
				SUBWF			0X20,W			;RESTA REG0X20-W Y LO GUARDA EN W
				BTFSS 			STATUS,C		;ES NEGATIVO?
				GOTO			NEGATIVO
CONTINUAR:		MOVWF			PORTC
				GOTO			FIN

NEGATIVO:		SUBLW			0X00
				BSF 			PORTB,7
				GOTO 			CONTINUAR
				
MULTIPLICACION:	BTFSS 			PORTB,3 	
				GOTO 			DIVISION
				MOVF 			PORTD,W			;CARGA PORTD EN W
				MOVWF			0X21

DEC_MULTI:		DECFSZ			0X20,F			;SKIP IF = 0		  
				GOTO 			SUMA_MULTI
				BTFSC			STATUS,C		;SOBREPASA EL ACARREO?
				BSF				PORTB,7
				MOVF			0X21,W			;CARGA EL RESULTADO DE LA SUMA EN W
				MOVWF			PORTC
				GOTO			FIN

SUMA_MULTI:		ADDWF			0X21,1			;SUMA W CON W Y LO GUARDA EN 0X20 (1) 
				GOTO			DEC_MULTI

DIVISION:		BTFSS			PORTB,0
				GOTO			SUMA
				MOVF 			PORTD,W			;CARGA PORTD -->> W
				MOVWF			0X21			;CARGA W -> 0X22

DEC_DIV:		SUBWF			0X20,1			;(REG0X20 - W) -->> REG0X20			
				BTFSC			STATUS,Z		;SKIP IF = 0         REG0X20 = 0?
				GOTO			RESUL_DIV		;Z = 1
				BTFSC			STATUS,C		;SKIP IF = 1	 Z = 0		REG0X20 < 0?	
				GOTO			RESIDUO			;C = 0
				INCF			0X22			;C = 1
				GOTO			DEC_DIV	


RESIDUO:		BSF				PORTB,7

RESUL_DIV		MOVF			0X22,W
				MOVWF 			PORTC

FIN:			GOTO			$
				END
				

				;0 = W
				;1 = REG